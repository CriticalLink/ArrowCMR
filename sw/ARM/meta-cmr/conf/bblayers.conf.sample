## sw/ARM/meta-cmr/conf/bblayers.conf.sample
```bitbake
# POKY_BBLAYERS_CONF_VERSION is increased each time build/conf/bblayers.conf
# changes incompatibly
POKY_BBLAYERS_CONF_VERSION = "2"

BBPATH = "${TOPDIR}"
BBFILES ?= ""
BBLAYERS_ROOT = "${TOPDIR}/.."

BBLAYERS ?= " \
  ${BBLAYERS_ROOT}/meta \
  ${BBLAYERS_ROOT}/meta-poky \
  ${BBLAYERS_ROOT}/meta-yocto-bsp \
  ${BBLAYERS_ROOT}/meta-cl-socfpga \
  ${BBLAYERS_ROOT}/meta-cmr \
  ${BBLAYERS_ROOT}/meta-openembedded/meta-oe \
  "
BBLAYERS_NON_REMOVABLE ?= " \
  ${BBLAYERS_ROOT}/meta \
  ${BBLAYERS_ROOT}/meta-yocto \
  "
```

## sw/ARM/meta-cmr/conf/layer.conf
```bitbake
# We have a conf and classes directory, append to BBPATH
BBPATH := "${LAYERDIR}:${BBPATH}"

# We have a recipes directory, add to BBFILES
BBFILES += "${LAYERDIR}/recipes*/*/*.bb ${LAYERDIR}/recipes*/*/*.bbappend"

BBFILE_COLLECTIONS += "cmr"
BBFILE_PATTERN_cmr := "^${LAYERDIR}/"
BBFILE_PRIORITY_cmr = "10"

LAYERSERIES_COMPAT_cmr = "zeus"
```
